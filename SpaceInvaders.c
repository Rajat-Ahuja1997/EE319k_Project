//Rajat Ahuja & Kunz Mainali
//Lab 10 - Chicken Little Game
//Fall 2016 - EE319K

#include <stdint.h>
#include "tm4c123gh6pm.h"
#include "ST7735.h"
#include "Random.h"
#include "TExaS.h"
#include "ADC.h"
#include <stdlib.h>
#include "Timer1.h"
#include "Timer0.h"
#include "DAC.h"
#include "Sound.h"



//Initial function initialization 
void DisableInterrupts(void); // Disable interrupts
void EnableInterrupts(void);  // Enable interrupts
void Delay100ms(uint32_t count); // time delay in 0.1 seconds
void Delay10ms(uint32_t count); //time delay .01 seconds 
void Delay1m(uint32_t count); //time delay .001 seconds 
void resetGame(void);
void shootLaser(void);
int getPB3(void);
void Timer1_Start(void);
void spawnBigBalls(void);
uint32_t ADC_In(void);
uint32_t conversion(uint32_t input);
void ADC_Init(void);
int finals;
int laserCount = 15;
int readyShoot = 1;



// *************************** Images ***************************
// blue ball that drops from the sky
// width=16 x height=16

const unsigned short sixteenball[] = { //acorn
 0x0000, 0x0000, 0x0000, 0x0000, 0x0000, 0x0000, 0x0000, 0x0000, 0x0000, 0x0000, 0x0000, 0x0000, 0x0000, 0x0000, 0x0000, 0x0000, 
 0x0000, 0x0000, 0x0000, 0x0000, 0x0000, 0x0000, 0xE73C, 0xCE7A, 0xB619, 0xBE39, 0xD6DB, 0xF79E, 0x0000, 0x0000, 0x0000, 0x0000, 
 0x0000, 0x0000, 0x0000, 0x0000, 0xEF7D, 0xC638, 0x7C74, 0x43B4, 0x3375, 0x3374, 0x4BB3, 0x7CB5, 0xD6FC, 0xFFDF, 0x0000, 0x0000, 
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 0x0000, 0x0000, 0x0000, 0x0000, 0x0000, 0x0000, 0x0000, 0x0000, 0x0000, 0x0000, 0x0000, 0x0000, 0x0000, 0x0000, 0x0000, 0x0000, 


};

//Rectangle that 'houses' laser amounts
const unsigned short store[] = {
 0xFFFF, 0xFFFF, 0xFFFF, 0xFFFF, 0xFFFF, 0xFFFF, 0xFFFF, 0xFFFF, 0xFFFF, 0xFFFF, 0xFFFF, 0xFFFF, 0xFFFF, 0xFFFF, 0xFFFF, 0xFFFF,
 0xFFFF, 0xFFFF, 0xFFFF, 0xFFFF, 0xFFFF, 0xFFFF, 0x0000, 0x0000, 0x0000, 0x0000, 0x0000, 0x0000, 0xFFFF, 0xFFFF, 0xFFFF, 0xFFFF,
 0x0000, 0x0000, 0x0000, 0x0000, 0x0000, 0x0000, 0xFFFF, 0xFFFF, 0xFFFF, 0xFFFF, 0x0000, 0x0000, 0x0000, 0x0000, 0x0000, 0x0000,
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 0x0000, 0x0000, 0x0000, 0x0000,

}; 
//Heart generator
const unsigned short life[] = {
 0x0000, 0x0000, 0x0000, 0x000D, 0x0007, 0x0000, 0x0000, 0x0000, 0x0000, 0x0000, 0x0011, 0x001F, 0x0016, 0x0004, 0x0000, 0x0000,
 0x0000, 0x000F, 0x001F, 0x001F, 0x001F, 0x0015, 0x0003, 0x0000, 0x0005, 0x001F, 0x001F, 0x001F, 0x001F, 0x001F, 0x0014, 0x0000,
 0x0016, 0x7BDF, 0x001F, 0x001F, 0x001F, 0x001F, 0x001C, 0x0007, 0x633C, 0x319F, 0x001F, 0x001F, 0x001F, 0x001F, 0x001F, 0x000D,
 0x0016, 0x949F, 0x10BF, 0x001A, 0x001C, 0x001F, 0x001C, 0x0007, 0x0000, 0x0038, 0x10BA, 0x0000, 0x0000, 0x001E, 0x0013, 0x0000,


};


const unsigned short startscreen[] = {
 0x2225, 0x32C6, 0x32C7, 0x3307, 0x1A23, 0x3B08, 0x2A66, 0x2A26, 0x2245, 0x3267, 0x2A86, 0x2A25, 0x2B27, 0x2A85, 0x4329, 0x2A86,
 0x3B48, 0x2266, 0x3307, 0x32C6, 0x3287, 0x3B28, 0x3307, 0x3AE7, 0x3327, 0x32C6, 0x2A86, 0x2B06, 0x2A85, 0x32A6, 0x3287, 0x3AC7,
 0x3B07, 0x2AA5, 0x3AE7, 0x2A86, 0x1183, 0x4329, 0x32C7, 0x32C7, 0x3AA7, 0x3AE7, 0x3AE8, 0x53AB, 0x53CB, 0x2A65, 0x2A85, 0x2AC6,
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 0xCDFA, 0xC5BA, 0xCDDA, 0xBD99, 0xBD9A, 0xC5BA,

};



// covers up the deleted acorn 
const unsigned short dead16[] = {
 0x0000, 0x0000, 0x0000, 0x0000, 0x0000, 0x0000, 0x0000, 0x0000, 0x0000, 0x0000, 0x0000, 0x0000, 0x0000, 0x0000, 0x0000, 0x0000,
 0x0000, 0x0000, 0x0000, 0x0000, 0x0000, 0x0000, 0x0000, 0x0000, 0x0000, 0x0000, 0x0000, 0x0000, 0x0000, 0x0000, 0x0000, 0x0000,
 0x0000, 0x0000, 0x0000, 0x0000, 0x0000, 0x0000, 0x0000, 0x0000, 0x0000, 0x0000, 0x0000, 0x0000, 0x0000, 0x0000, 0x0000, 0x0000,
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 0x0000, 0x0000, 0x0000, 0x0000, 0x0000, 0x0000, 0x0000, 0x0000, 0x0000, 0x0000, 0x0000, 0x0000, 0x0000, 0x0000, 0x0000, 0x0000,
};

const unsigned short gameover[] = {
 0x0000, 0x0000, 0x0000, 0x0000, 0x0000, 0x0000, 0x0000, 0x0000, 0x0000, 0x0000, 0x0000, 0x0000, 0x0000, 0x0000, 0x0000, 0x0000,
 0x0000, 0x0000, 0x0000, 0x0000, 0x0000, 0x0000, 0x0000, 0x0000, 0x0000, 0x0000, 0x0000, 0x0000, 0x0000, 0x0000, 0x0000, 0x0000,
 0x0000, 0x0000, 0x0000, 0x0000, 0x0000, 0x0000, 0x0000, 0x0000, 0x0000, 0x0000, 0x0000, 0x0000, 0x0000, 0x0000, 0x0000, 0x0000,
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 0x0000, 0x0000, 0x0000, 0x0000,

};
/* Main character 
width: 10 pixels, height: 18 pixels
Chicken Char
*/
const unsigned short mainchar[] = { 
 0x0000, 0x0000, 0x0000, 0xE79F, 0xAEBF, 0xAEDF, 0xEFBF, 0x0000, 0x0000, 0x0000, 0x0000, 0x0000, 0x0000, 0x0000, 0x44DA, 0x54F8,
 0x0000, 0x0000, 0x0000, 0x0000, 0x0000, 0x0000, 0x0000, 0xEF7D, 0x055C, 0x055C, 0xEF7D, 0x0000, 0x0000, 0x0000, 0x0000, 0x0000,
 0xCEDB, 0x03D5, 0x061F, 0x061F, 0x03F6, 0xAE5A, 0x0000, 0x0000, 0x0000, 0x0000, 0xB65A, 0x04FB, 0x0DDE, 0x0DDE, 0x051B, 0x9DD8,
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 0xDEDE, 0x0000, 0x0000, 0x0000,

};

//Deleted the Chicken Char when it is moved
const unsigned short blm[] = { 
 0x0000, 0x0000, 0x0000, 0x0000, 0x0000, 0x0000, 0x0000, 0x0000, 0x0000, 0x0000, 0x0000, 0x0000, 0x0000, 0x0000, 0x0000, 0x0000,
 0x0000, 0x0000, 0x0000, 0x0000, 0x0000, 0x0000, 0x0000, 0x0000, 0x0000, 0x0000, 0x0000, 0x0000, 0x0000, 0x0000, 0x0000, 0x0000,
 0x0000, 0x0000, 0x0000, 0x0000, 0x0000, 0x0000, 0x0000, 0x0000, 0x0000, 0x0000, 0x0000, 0x0000, 0x0000, 0x0000, 0x0000, 0x0000,
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 0x0000, 0x0000, 0x0000, 0x0000, 0x0000, 0x0000, 0x0000, 0x0000,

};



struct character{
	int x1;
	int y1;
};
int numLives;
struct lives{
	int x1;
	int y1;
	char hit;
};
struct lives health[3];
struct character char1[1];
void spawnCharacter(){
	char1[0].x1 = 45;
	char1[0].y1 = 140;
	//ST7735_DrawBitmap(char1[0].x1,char1[0].y1, character1,20 ,36);

}

void SysTick_Init(void){
	NVIC_ST_CTRL_R	=	0;							//	disable	SysTick	during setup
	NVIC_ST_RELOAD_R	=	2000000;			//	reload	value
	NVIC_ST_CURRENT_R	=	0;						//	any	write	to current clears	it
	NVIC_SYS_PRI3_R	=	(NVIC_SYS_PRI3_R&0x00FFFFFF)|0x40000000;	//	priority	2														
	NVIC_ST_CTRL_R = NVIC_ST_CTRL_ENABLE + NVIC_ST_CTRL_CLK_SRC + NVIC_ST_CTRL_INTEN;
	//	enable	SysTick	with	core	clock	and	interrupts
}

void	SysTick_Handler(void){
	uint32_t temp = ADC_In();
	
	//If button is pressed and there is a laser
	if((getPB3() != 0) && (readyShoot == 1)){
		shootLaser();
		soundLaser();
		
		laserCount--;
		if(laserCount == 0){
			laserCount = 15;
			readyShoot = 1;}
		else
			readyShoot = 0;
	}
	if(getPB3() == 0){
		laserCount = 15;
		readyShoot = 1;}
	
	temp = conversion(temp); 
	if (temp== char1[0].x1 || temp+1== char1[0].x1 || temp-1 == char1[0].x1 || temp-2 == char1[0].x1 || temp+2 == char1[0].x1)
		return;
	ST7735_DrawBitmap(char1[0].x1,char1[0].y1, blm ,10 ,36);
	char1[0].x1 = temp;
	ST7735_DrawBitmap(char1[0].x1,char1[0].y1, mainchar ,10 ,18);

}

unsigned long TimerCount;
void Timer2_Init(unsigned long period){ 
  unsigned long volatile delay;
  SYSCTL_RCGCTIMER_R |= 0x04;   // 0) activate timer2
  delay = SYSCTL_RCGCTIMER_R;
  TimerCount = 0;
  TIMER2_CTL_R = 0x00000000;   // 1) disable timer2A
  TIMER2_CFG_R = 0x00000000;   // 2) 32-bit mode
  TIMER2_TAMR_R = 0x00000002;  // 3) periodic mode
  TIMER2_TAILR_R = period-1;   // 4) reload value
  TIMER2_TAPR_R = 0;           // 5) clock resolution
  TIMER2_ICR_R = 0x00000001;   // 6) clear timeout flag
  TIMER2_IMR_R = 0x00000001;   // 7) arm timeout
  NVIC_PRI5_R = (NVIC_PRI5_R&0x00FFFFFF)|0x80000000; // 8) priority 4
  NVIC_EN0_R = 1<<23;          // 9) enable IRQ 23 in
  TIMER2_CTL_R = 0x00000001;   // 10) enable timer2A
}
int score=0;

//Initalized PortB as the port that controls the switch input
void PB3_Init(void){
	uint32_t delay =0;
	SYSCTL_RCGCGPIO_R |= 0x02;
	delay = SYSCTL_RCGCGPIO_R;
	delay++;

	GPIO_PORTB_AFSEL_R &= ~0x01;
	GPIO_PORTB_AMSEL_R &= ~0x01;
	GPIO_PORTB_DIR_R &= ~0x01;
	GPIO_PORTB_PCTL_R &= ~0x00F0000;
	GPIO_PORTB_DEN_R |= 0x01;	//Pin B0 is used as the switch button - starts the game and is also a laser

}
int getPB3(void){
	return GPIO_PORTB_DATA_R;
}
//Creates small acorns - not used in the final game
struct smallballs{
	char bounceTime;
	int *ball;
	int x1;
	int x2;
	int y1;
	int y2;
	char alive;
};
//Creates medium-sized acorns - not used in the final game
struct medballs{
	int bounceTime;
	int *ball;
	int x1;
	int x2;
	int y1;
	int y2;
	char alive;
	char radius;
};
//Creates large acorns - used in the final game
struct bigballs{
	int bounceTime;
	const short *ball;
	int x1;
	int x2;
	int y1;
	int y2;
	char alive;
	char radius;
};

struct laser{
	int x1;
	int y1;
	int alive;
	int count;
};


struct bigballs bigball[7];
struct laser lzr[3];
int offset2 = 0;
void Timer2A_Handler(void){
  TIMER2_ICR_R = 0x00000001;  // acknowledge
	score++;										//Score is reached as a function of time
	ST7735_SetCursor(12, 15);
	LCD_OutDec(score);
	if(score%10 == 0 && lzr[0].count <=5){
		lzr[0].count++;
		if (lzr[0].count ==1)
			offset2=0;
		else if(lzr[0].count == 2)
			offset2=9;
		else if (lzr[0].count == 3)
			offset2 = 17;
		else if (lzr[0].count == 4)
			offset2 = 25;
		else if (lzr[0].count == 5)
			offset2 = 34;
		
		ST7735_FillRect(120,93- offset2,6,7, 0x001F);
	}
	// run some background stuff here
}
//Actually spawns the large acorns that the char needs to dodge
void spawnBigBalls(void){
	int offset = 0;
	int count =0;
	int  rate = (rand()) % 5;
	int i=0;
	for (i=0; i<5; i++){
		rate = rand() % 5;
		if(bigball[i].alive)
			continue;
		if( rate < 3){
			bigball[i].alive = 1; //random to set
			bigball[i].x1 = 10 + offset; //randomize
			bigball[i].y1= 0;
			count ++;
		}
		else bigball[i].alive = 0;
		offset += 20 ;

	}
	if (count == 6)
		bigball[rand()&5].alive =0;
	//check spawn to make sure if 6 if ==6 delete a random one 
}

void Timer0_Stop(void){ 
  TIMER0_CTL_R &= ~0x00000001; // disable
}
void Timer0_Start(void){ 
  TIMER0_CTL_R |= 0x00000001;   // enable
}

void Timer1_Stop(void){ 
  TIMER1_CTL_R &= ~0x00000001; // disable
}
void Timer1_Start(void){ 
  TIMER1_CTL_R |= 0x00000001;   // enable
}

void Timer2_Stop(void){ 
  TIMER2_CTL_R &= ~0x00000001; // disable
}
void Timer2_Start(void){ 
  TIMER2_CTL_R |= 0x00000001;   // enable
}

void Timer3_Stop(void){
	TIMER3_CTL_R &= ~0x00000001; // disable


}

//Function to delete the acorns as they move downward
void despawn(int index)
{
	
	bigball[index].alive=0;
	ST7735_DrawBitmap(bigball[index].x1,bigball[index].y1,dead16, 16,16); 
	//draw black where it was
	// delay 5 sec at 80 MHz

}

//"Redraws" the acorns as a continually shifting downward y-position
void redrawBalls(void) 
{
	int k=0;
	for(k=0; k<6; k++){
		if(bigball[k].alive == 0);
			else
			{
			if (bigball[k].y1+bigball[k].radius >= 137)
			{
				despawn(k);
			}
			else{
			ST7735_DrawBitmap(bigball[k].x1,bigball[k].y1,sixteenball, 16,16); 
			bigball[k].y1 += 2;
			}
		}
	}
}
//Highscore is saved only for one session
int highscore = 0;
//Home screen - Has basic instructions
void startScreen(void){
	//init timer 1 and make play sounds
	Timer1_Init(&sound, 10000);
  ST7735_FillScreen(0x0000);  	// set screen to black
	ST7735_DrawBitmap(35,160,startscreen,50,75);
	ST7735_DrawString(1,2, "Chicken Little Dash!", 0xFFE0);
	ST7735_DrawString(2,3, "Avoid getting hit", 0xFFE0);
	ST7735_DrawString(4,4, "by the acorns!", 0xFFE0);
	ST7735_DrawString(4,5, "Hit the button", 0xFFE0);
	ST7735_DrawString(6,6, "to start!", 0xFFE0);


	ST7735_SetCursor(4, 7);
	ST7735_OutString("High Score: ");
  LCD_OutDec(highscore);
  Delay10ms(10);
	Timer1_Init(&sound, 10000);
	while(getPB3() == 0);              // change to wait to hit the button to start 
	Delay10ms(30);
}


//If char and big ball occupy the same space, subtract a life from the main character
int checkCollision(char x, char y){
	int k =0;	
	for(k=0; k<6; k++){
		if(bigball[k].alive)
			if(bigball[k].x1+14 >= x && bigball[k].x1 <= x+8)
					if(bigball[k].y1 >= 126 && bigball[k].y1<= 140)
					{
						if(numLives > 0){
							ST7735_FillRect(health[numLives].x1, health[numLives].y1-8, 8, 8, 0x0000);
							despawn(k);
							numLives--;
							return 1;
						}
						
						else{
							finals = score;
							for(k = 0; k < 10000; k++)
								Timer1_Init(&sound, 90);
							return 0;
						}
					}
	}
	return 1;
}
void shootLaser(void){
	DisableInterrupts();
	if(lzr[0].count ==0)
		return;
//	while(getPB3() != 0);
	
	if (lzr[0].count ==1)
			offset2=0;
	else if(lzr[0].count == 2)
			offset2=9;
	else if (lzr[0].count == 3)
			offset2 = 17;
	else if (lzr[0].count == 4)
			offset2 = 25;
	else if (lzr[0].count == 5)
			offset2 = 34;
	
	ST7735_FillRect(120,93- offset2,6,7, 0x0000);
	lzr[0].count--;
	lzr[0].x1 = char1[0].x1+5;
	lzr[0].y1 = 122;
	lzr[0].alive = 1;
	ST7735_DrawFastVLine(lzr[0].x1, 0 , lzr[0].y1,  0x20FD);
	Timer1_Start();
  EnableInterrupts();

}

//If laser hits the acorn, despawn (delete) the acorn
void laserCollision(void){
	int k=0;
	Timer1_Stop();
	if(lzr[0].alive == 0)
		return; 
	for (k=0; k<5; k++)
	{
		if(lzr[0].x1 >= bigball[k].x1 && lzr[0].x1 <= bigball[k].x1 + 16)
			despawn(k);
	}
	ST7735_DrawFastVLine(lzr[0].x1, 0 , lzr[0].y1,  0x0000);
	lzr[0].alive = 0;
}

//check to make sure that none of the balls are being hit the radius of another 


//Main function to be run
int main(void){
	PB3_Init();		 //Initalizes the switch
	TExaS_Init();  // set system clock to 80 MHz
  Random_Init(1);	//Random orientation of acorns
	ADC_Init();			//Calculates position of char
  Output_Init();
	DAC_Init();			//Sounds
	startScreen();
	//Timer1_Init(&sound, 10000);

	
	start:  ST7735_FillScreen(0x0000);  
	Timer2_Init(45500000);
	// set screen to black
	lzr[0].count = 1;
	int offset3 = 0;
	numLives =0;
	for(int k=0; k<3; k++)
	{
		health[k].hit=1;
		health[k].x1 =0;
		health[k].y1 =20+offset3;
		ST7735_DrawBitmap(health[k].x1, health[k].y1, life, 8,8);		
		numLives++;
		offset3 += 10;
	}
	numLives--;
	ST7735_FillRect(10, 141,100,19, 0x2c98);
	ST7735_DrawBitmap(118, 100, store, 10, 50);
	ST7735_FillRect(120,93- offset2,6,7, 0x001F);
	ST7735_DrawFastVLine(9, 0, 160, 0xFFFF);
	ST7735_DrawFastVLine(110, 0, 160, 0xFFFF);
	
	ST7735_SetCursor(6, 15);
	ST7735_OutString("Score: ");
	Timer1_Init(&laserCollision, 3000000);
	Timer0_Init(&spawnBigBalls,50000000);	//80000000
//	Timer3_Init(&laserSound, );
	SysTick_Init();
	
	
	int condition=1;

	spawnCharacter();
	spawnBigBalls();
	Timer2_Init(45500000);// alt 80000000
	while(condition){
			
			DisableInterrupts();
			redrawBalls();  
		  EnableInterrupts(); // Enable interrupts
	
			condition = checkCollision(char1[0].x1, char1[0].y1);
			Delay1m(5);
	}
	Timer1_Init(&sound, 10000);
	//make array 
	DisableInterrupts();
	Timer0_Stop();
	Timer1_Stop();
	Timer2_Stop();
	Timer1_Init(&sound, 10000);
	Delay100ms(10);              // delay 5 sec at 80 MHz
	
	while(1){
		Timer1_Init(&sound, 10000);
		if(finals> highscore)
			highscore = finals;
		
		ST7735_FillScreen(0x0000);		// set screen to black
		ST7735_DrawBitmap(39,100, gameover, 50, 50);	//GameOver sequence, invites players to play again
		ST7735_SetCursor(3,12);
		ST7735_OutString("Press the button");			
		ST7735_SetCursor(4,13);
		ST7735_OutString("to play again!");	
		ST7735_SetCursor(3,14);
		ST7735_OutString("Your Score:");
		LCD_OutDec(finals);
		while(getPB3() == 0);		//If switch is pressed, restart the game
		resetGame();
		offset2 = 0;
		goto start;

	}	
	
}


// You can use this timer only if you learn how it works

void Delay100ms(uint32_t count){uint32_t volatile time;
  while(count>0){
    time = 727240;  // 0.1sec at 80 MHz
    while(time){
	  	time--;
    }
    count--;
  }
}
void Delay10ms(uint32_t count){uint32_t volatile time;
  while(count>0){
    time = 72724;  // 0.1sec at 80 MHz
    while(time){
	  	time--;
    }
    count--;
  }
}
void Delay1m(uint32_t count){uint32_t volatile time;
  while(count>0){
    time = 7272;  // 0.1sec at 80 MHz
    while(time){
	  	time--;
    }
    count--;
  }
}
	
void resetGame(void){
	for(int k = 0; k<6; k++)
		despawn(k);
	score =0;
	lzr[0].count =1;
	startScreen();
	return;
	
}
uint32_t conversion(uint32_t input){
	return 12+(input*100*255 + 88279)/10000/120;
}
